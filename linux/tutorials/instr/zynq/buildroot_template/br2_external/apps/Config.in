## linux/tutorials/instr/zynq/buildroot_template/br2_external/apps/Config.in
```kconfig
source "$BR2_EXTERNAL_Z_APPS_PATH/package/app1/Config.in"
source "$BR2_EXTERNAL_Z_APPS_PATH/package/app2/Config.in"
```

## linux/tutorials/instr/zynq/buildroot_template/br2_external/apps/package/app1/Config.in
```kconfig
config BR2_PACKAGE_APP1
    bool "Test Application 1"
    help
        Test application
```

## linux/tutorials/instr/zynq/buildroot_template/br2_external/apps/package/app2/Config.in
```kconfig
config BR2_PACKAGE_APP2
    bool "Test Application 2"
    help
        Test application
```

## linux/tutorials/instr/zynq/buildroot_template/br2_external/kernel_modules/Config.in
```kconfig
source "$BR2_EXTERNAL_KERNEL_MODULES_PATH/package/hi/Config.in"
source "$BR2_EXTERNAL_KERNEL_MODULES_PATH/package/buzz/Config.in"
#source "$BR2_EXTERNAL_KERNEL_MODULES_PATH/package/leds/Config.in"
#source "$BR2_EXTERNAL_KERNEL_MODULES_PATH/package/buts/Config.in"
```

## linux/tutorials/instr/zynq/buildroot_template/br2_external/kernel_modules/package/buts/Config.in
```kconfig
config BR2_PACKAGE_KERNEL_MODULE_BUTS
	bool "kernel_module_buts"
	depends on BR2_LINUX_KERNEL
	help
		See README
```

## linux/tutorials/instr/zynq/buildroot_template/br2_external/kernel_modules/package/buzz/Config.in
```kconfig
config BR2_PACKAGE_KERNEL_MODULE_BUZZ
	bool "kernel_module_BUZZ"
	depends on BR2_LINUX_KERNEL
	help
		See README
```

## linux/tutorials/instr/zynq/buildroot_template/br2_external/kernel_modules/package/hi/Config.in
```kconfig
config BR2_PACKAGE_KERNEL_MODULE_HI
	bool "kernel_module_HI"
	depends on BR2_LINUX_KERNEL
	help
		See README
```

## linux/tutorials/instr/zynq/buildroot_template/br2_external/kernel_modules/package/leds/Config.in
```kconfig
config BR2_PACKAGE_KERNEL_MODULE_LEDS
	bool "kernel_module_leds"
	depends on BR2_LINUX_KERNEL
	help
		See README
```

## linux/tutorials/instr/zynq/buildroot_template/ebaz.its
```
/dts-v1/;

/ {
    description = "Ebaz";
    #address-cells = <1>;
    images {
        kernel-1 {
            data = /incbin/("kernel/arch/arm/boot/zImage");
            type = "kernel";
            arch = "arm";               
            os = "linux";
            compression = "none";
            load = <0x2000000>;
            entry = <0x2000000>;
            hash-1 {
                algo = "sha256";
            };
        };
        fpga-1 {
            description = "PL Bitstream";
            data = /incbin/("xsa/driver.bit");
            type = "fpga";
            arch = "arm";
            compression = "none";
            load = <0x00100000>;
            hash-1 {
                algo = "sha256";
            };
        };
        fdt-1 {
            description = "FDT";
            data = /incbin/("ebaz.dtb");
            type = "flat_dt";
            arch = "arm";
            os = "linux";
            compression = "none";
            load = <0x1F00000>;
            hash-1 {
                algo = "sha256";
            };
        };
        ramdisk-1 {
            description = "RAM fs";
            data = /incbin/("buildroot/images/rootfs.cpio.lzma");
            type = "ramdisk";
            arch = "arm";               
            os = "linux";
            compression = "lzma";
            load = <0x6000000>;
            entry = <0x6000000>;
            hash-1 {
                algo = "sha256";
            };
        };
    };
    configurations {
        default = "conf-1";
        conf-1 {
            description = "DEfault config";
            kernel = "kernel-1";
            fpga = "fpga-1";
            fdt = "fdt-1";
            ramdisk = "ramdisk-1";
            hash-1 {
                algo = "sha256";
            };
        };
    };
};
```

## linux/tutorials/instr/zynq/buildroot_template/fit/wo_fpga/ebaz.its
```
/dts-v1/;

/ {
    description = "Ebaz";
    #address-cells = <1>;
    images {
        kernel-1 {
            data = /incbin/("buildroot/images/zImage");
            type = "kernel";
            arch = "arm";               
            os = "linux";
            compression = "none";
            load = <0x2000000>;
            entry = <0x2000000>;
            hash-1 {
                algo = "sha256";
            };
        };
        fdt-1 {
            description = "FDT";
            data = /incbin/("ebaz.dtb");
            type = "flat_dt";
            arch = "arm";
            os = "linux";
            compression = "none";
            load = <0x1F00000>;
            hash-1 {
                algo = "sha256";
            };
        };
        ramdisk-1 {
            description = "RAM fs";
            data = /incbin/("buildroot/images/rootfs.cpio.lzma");
            type = "ramdisk";
            arch = "arm";               
            os = "linux";
            compression = "lzma";
            load = <0x5000000>;
            entry = <0x5000000>;
            hash-1 {
                algo = "sha256";
            };
        };
    };
    configurations {
        default = "conf-1";
        conf-1 {
            description = "DEfault config";
            kernel = "kernel-1";
            fdt = "fdt-1";
            ramdisk = "ramdisk-1";
            hash-1 {
                algo = "sha256";
            };
        };
    };
};
```
